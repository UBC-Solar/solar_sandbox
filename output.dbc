VERSION ""

NS_ :

BS_:

BU_:

BO_ 1793 voltagesensorsdata: 64 Vector__XXX
 SG_ voltsensor2 : 32|32@0+ (0,0) [0.0|0.0] "V" Vector__XXX
 SG_ voltsensor1 : 0|32@0+ (0,0) [0.0|0.0] "V" Vector__XXX
